## CMakeLists.txt
```
cmake_minimum_required(VERSION 3.20.0)
find_package(Zephyr REQUIRED HINTS $ENV{ZEPHYR_BASE})

project(app CXX ASM)

set(CMAKE_CXX_STANDARD 14)

add_compile_options(-fexceptions)

include_directories( src/thread_component src/event src/application src/interface src/drivers src/components)

# Add our main executable
FILE(GLOB app_sources src/*.cpp 
                      src/thread_component/*.cpp 
                      src/thread_component/*.hpp
                      src/event/*hpp
                      src/application/*cpp
                      src/application/*.hpp
                      src/interface/*.cpp
                      src/interface/*.hpp
                      src/drivers/*.hpp
                      src/drivers/*.cpp
                      src/components/*.cpp
                      src/components/*.hpp)

target_sources(app PRIVATE ${app_sources}) 
```

## prj.conf
```kconfig
CONFIG_SHELL=y
CONFIG_LOG=y
CONFIG_UART_CONSOLE=y
CONFIG_CONSOLE=y

CONFIG_LOG_BACKEND_UART=y
CONFIG_NEWLIB_LIBC=y

CONFIG_GPIO=y

CONFIG_PRINTK=y
CONFIG_CPP=y
CONFIG_HEAP_MEM_POOL_SIZE=4096
CONFIG_STD_CPP14=y
CONFIG_GLIBCXX_LIBCPP=y

CONFIG_HW_STACK_PROTECTION=y
CONFIG_THREAD_NAME=y

CONFIG_NVS=y
CONFIG_SETTINGS=y
CONFIG_REBOOT=y
CONFIG_FLASH=y
CONFIG_FLASH_PAGE_LAYOUT=y
CONFIG_FLASH_MAP=y

# Stack sizes
CONFIG_SYSTEM_WORKQUEUE_STACK_SIZE=2048
CONFIG_MAIN_STACK_SIZE=2048

# Enable USB
CONFIG_USB_DEVICE_STACK=y
CONFIG_USB_DEVICE_PRODUCT="Your Product"
CONFIG_USB_DEVICE_PID=0x5201
CONFIG_USB_DEVICE_INITIALIZE_AT_BOOT=n

CONFIG_SERIAL=y
CONFIG_UART_INTERRUPT_DRIVEN=y
CONFIG_UART_LINE_CTRL=y

# IMU/Sensor Framework
CONFIG_SENSOR=y
CONFIG_LSM6DSL_TRIGGER_GLOBAL_THREAD=y
CONFIG_CBPRINTF_FP_SUPPORT=y
CONFIG_FPU=y
```

## src/main.cpp
```c
#include <iostream>
#include <cstdint>

#include "component_base.hpp"
#include "main_application.hpp"

int main(void)
{
    
    static MainApplication app_main;
    app_main.start();
    return 0;
}
```
